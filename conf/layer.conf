## conf/layer.conf
```bitbake
# We have a conf and classes directory, add to BBPATH
BBPATH .= ":${LAYERDIR}"

# We have a packages directory, add to BBFILES
BBFILES += "${LAYERDIR}/recipes-*/*/*.bb \
            ${LAYERDIR}/recipes-*/*/*.bbappend"

BBFILE_COLLECTIONS += "qemuextras"
BBFILE_PATTERN_qemuextras := "^${LAYERDIR}/"
BBFILE_PRIORITY_qemuextras = "5"

BB_ENV_EXTRAWHITE := "KSRC"
```

## conf/machine/qemumips64.conf
```bitbake
#@TYPE: Machine
#@NAME: mti_malta64 MIPS64
#@DESCRIPTION: mti_malta64

require conf/machine/include/qemu.inc
require conf/machine/include/tune-mips64.inc

KERNEL_IMAGETYPE = "vmlinux"
KERNEL_ALT_IMAGETYPE = "vmlinux.bin"

SERIAL_CONSOLE = "115200 ttyS0"

MACHINE_EXTRA_RRECOMMENDS = " kernel-modules"
```
